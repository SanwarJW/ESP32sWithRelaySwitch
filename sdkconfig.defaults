## sdkconfig.defaults
```kconfig
# Flash size configuration for 2MB ESP32
CONFIG_ESPTOOLPY_FLASHSIZE_2MB=y
CONFIG_ESPTOOLPY_FLASHSIZE="2MB"
CONFIG_PARTITION_TABLE_SINGLE_APP=y

# Console UART configuration
CONFIG_ESP_CONSOLE_UART_BAUDRATE=115200
```
